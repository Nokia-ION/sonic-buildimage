## platform/ast/sonic_fit.its
```
/dts-v1/;
  
/ {
    description = "U-Boot fitImage for SONIC AST";
    #address-cells = <1>;
  
    images {
        kernel-1 {
            description = "Linux Kernel";
            data = /incbin/("/boot/vmlinuz-6.12.41+deb13-sonic-arm64");
            type = "kernel";
            arch = "arm64";
            os = "linux";
            compression = "none";
            load = <0x4 0x00000000>;
            entry = <0x4 0x00000000>;
            hash-1 {
                algo = "sha1";
            };
        };
        fdt-ast2700-evb {
            description = "Flattened Device Tree blob";
            data = /incbin/("/usr/lib/linux-image-6.12.41+deb13-sonic-arm64/aspeed/ast2700-evb.dtb");
            type = "flat_dt";
            arch = "arm64";
            compression = "none";
            hash-1 {
                algo = "sha1";
            };
        };
        ramdisk-1 {
            description = "ramdisk for AST";
            data = /incbin/("/boot/initrd.img-6.12.41+deb13-sonic-arm64");
            type = "ramdisk";
            arch = "arm64";
            os = "linux";
            hash-1 {
                algo = "sha1";
            };
        };
    };
    configurations {
        default = "conf-ast2700-evb";
        conf-ast2700-evb {
            description = "Boot Linux kernel with FDT blob + ramdisk for AST";
            kernel = "kernel-1";
            fdt = "fdt-ast2700-evb";
            ramdisk = "ramdisk-1";
            hash-1 {
                algo = "sha1";
            };
        };
    };
};
```
